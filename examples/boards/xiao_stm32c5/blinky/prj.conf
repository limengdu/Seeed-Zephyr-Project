## CMakeLists.txt
```
cmake_minimum_required(VERSION 3.20.0)

find_package(Zephyr REQUIRED HINTS $ENV{ZEPHYR_BASE})
project(xiao_stm32c5_blinky)

target_sources(app PRIVATE src/main.c)
```

## prj.conf
```kconfig
CONFIG_GPIO=y
CONFIG_PRINTK=y
CONFIG_UART_LINE_CTRL=y

# USB identity of the XIAO STM32C5 application (2886:00C5).
# XIAO STM32C5 应用程序的 USB 标识（2886:00C5）。
CONFIG_CDC_ACM_SERIAL_VID=0x2886
CONFIG_CDC_ACM_SERIAL_PID=0x00C5
CONFIG_CDC_ACM_SERIAL_MANUFACTURER_STRING="Seeed Studio"
CONFIG_CDC_ACM_SERIAL_PRODUCT_STRING="XIAO STM32C5"

# TinyUF2 image for the factory bootloader (family id 0x00C5C5C5).
# 面向出厂引导程序的 TinyUF2 镜像（family id 0x00C5C5C5）。
CONFIG_BUILD_OUTPUT_UF2=y
CONFIG_BUILD_OUTPUT_UF2_FAMILY_ID="0x00C5C5C5"
```

## boards/xiao_stm32c5_stm32c5a3xx.overlay
```dts
/*
 * USB device clock and pins for the XIAO STM32C5.
 * Selects the 48 MHz HSE as the USB clock source and routes PA11/PA12 to USB.
 * XIAO STM32C5 的 USB 设备时钟与引脚。
 * 选用 48 MHz HSE 作为 USB 时钟源，并把 PA11/PA12 交给 USB。
 *
 * TODO(zephyr-baseline): drop this file once the Zephyr baseline ships the
 * XIAO STM32C5 clk48 and USB pin settings in the board definition.
 */

&clk48 {
	clocks = <&rcc STM32_SRC_HSE CK48_SEL(3)>;
	status = "okay";
};

&usb {
	pinctrl-0 = <&usb_dm_pa11 &usb_dp_pa12>;
	pinctrl-names = "default";
};
```

## src/main.c
```c
#include <stdbool.h>

#include <cmsis_core.h>
#include <zephyr/drivers/gpio.h>
#include <zephyr/drivers/uart.h>
#include <zephyr/irq.h>
#include <zephyr/kernel.h>
#include <zephyr/sys/printk.h>

#define SLEEP_TIME_MS 1000
#define BOOTLOADER_POLL_INTERVAL_MS 50
#define BOOTLOADER_BAUD_RATE 1200U
#define UF2_DBL_TAP_MAGIC 0xf01669efUL
#define UF2_DBL_TAP_ADDR (DT_REG_ADDR(DT_NODELABEL(sram1)) + \
                         DT_REG_SIZE(DT_NODELABEL(sram1)) - sizeof(uint32_t))
#define LED0_NODE DT_ALIAS(led0)

#if !DT_NODE_HAS_STATUS(LED0_NODE, okay)
#error "This board demo requires a led0 devicetree alias."
#endif

static const struct gpio_dt_spec led = GPIO_DT_SPEC_GET(LED0_NODE, gpios);
static const struct device *const cdc_acm = DEVICE_DT_GET(DT_CHOSEN(zephyr_console));

/* Stores the TinyUF2 request in the last SRAM word and resets the processor.
 * 在 SRAM 最后一个字中写入 TinyUF2 请求，并复位处理器。
 */
static void reboot_to_bootloader(void)
{
	(void)irq_lock();
	*(volatile uint32_t *)UF2_DBL_TAP_ADDR = UF2_DBL_TAP_MAGIC;
	__DSB();
	NVIC_SystemReset();
}

/* Polls USB CDC line settings during the LED interval.
 * 在 LED 切换间隔内轮询 USB CDC 串口设置。
 */
static void sleep_with_bootloader_checks(void)
{
	for (int elapsed_ms = 0; elapsed_ms < SLEEP_TIME_MS;
	     elapsed_ms += BOOTLOADER_POLL_INTERVAL_MS) {
		uint32_t baudrate = 0U;

		if (device_is_ready(cdc_acm) &&
		    uart_line_ctrl_get(cdc_acm, UART_LINE_CTRL_BAUD_RATE, &baudrate) == 0 &&
		    baudrate == BOOTLOADER_BAUD_RATE) {
			reboot_to_bootloader();
		}
		k_msleep(BOOTLOADER_POLL_INTERVAL_MS);
	}
}

int main(void)
{
	printk("*** Seeed XIAO Zephyr Base | board: %s | demo: %s ***\n", CONFIG_BOARD, "blinky");

	int ret;
	bool led_is_on = true;

	if (!gpio_is_ready_dt(&led)) {
		printk("LED device is not ready.\n");
		return 0;
	}

	ret = gpio_pin_configure_dt(&led, GPIO_OUTPUT_ACTIVE);
	if (ret < 0) {
		printk("LED configuration failed: %d\n", ret);
		return 0;
	}

	while (1) {
		ret = gpio_pin_toggle_dt(&led);
		if (ret < 0) {
			printk("LED toggle failed: %d\n", ret);
			return 0;
		}

		led_is_on = !led_is_on;
		printk("LED state: %s\n", led_is_on ? "ON" : "OFF");
		sleep_with_bootloader_checks();
	}

	return 0;
}
```
