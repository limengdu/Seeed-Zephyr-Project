## examples/grove/grove_ultrasonic_distance_sensor/basic_read/boards/seeeduino_xiao.conf
```kconfig
CONFIG_SERIAL=y
CONFIG_CONSOLE=y
CONFIG_UART_CONSOLE=y
CONFIG_STDOUT_CONSOLE=y
CONFIG_UART_LINE_CTRL=y
CONFIG_USB_DEVICE_STACK=y
CONFIG_DEPRECATION_TEST=y
CONFIG_USB_DEVICE_VID=0x2886
CONFIG_USB_DEVICE_PRODUCT="Seeed XIAO SAMD21 ultrasonic"
CONFIG_USB_DEVICE_MANUFACTURER="Seeed Studio"
CONFIG_USB_DEVICE_PID=0x0004
CONFIG_USB_DEVICE_INITIALIZE_AT_BOOT=n
CONFIG_USB_DEVICE_STACK_NEXT=n
```

## examples/grove/grove_ultrasonic_distance_sensor/basic_read/boards/xiao_ble.conf
```kconfig
CONFIG_REBOOT=y
CONFIG_SERIAL=y
CONFIG_CONSOLE=y
CONFIG_UART_CONSOLE=y
CONFIG_UART_LINE_CTRL=y
CONFIG_BOOT_DELAY=500
```

## examples/grove/grove_ultrasonic_distance_sensor/basic_read/boards/xiao_ra4m1.conf
```kconfig
CONFIG_REBOOT=y
CONFIG_FLASH_LOAD_OFFSET=0x4000
CONFIG_CONSOLE=y
CONFIG_UART_CONSOLE=y
CONFIG_STDOUT_CONSOLE=y
CONFIG_UART_LINE_CTRL=y
CONFIG_USB_DEVICE_STACK_NEXT=y
CONFIG_CDC_ACM_SERIAL_INITIALIZE_AT_BOOT=y
CONFIG_CDC_ACM_SERIAL_VID=0x2886
CONFIG_CDC_ACM_SERIAL_PID=0x0049
CONFIG_CDC_ACM_SERIAL_MANUFACTURER_STRING="Seeed Studio"
CONFIG_CDC_ACM_SERIAL_PRODUCT_STRING="XIAO RA4M1 Zephyr Grove"
```
